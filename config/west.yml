## config/west.yml
```yaml
manifest:
  remotes:
    - name: zmkfirmware
      url-base: https://github.com/zmkfirmware
    - name: jgliao248
      url-base: https://github.com/jgliao248
  projects:
    - name: zmk
      remote: infused-kim
      revision: sofle
      import: app/west.yml
  self:
    path: config
```
